## external/package/mscc-mrp/Config.in
```kconfig
config BR2_PACKAGE_MSCC_MRP
	bool "mscc-mrp"
	select BR2_PACKAGE_LIBNL
	select BR2_PACKAGE_LIBEV
	select BR2_PACKAGE_LIBMNL
	select BR2_PACKAGE_MSCC_CFM
	help
	  Media Redundancy Protocol state machine
```

## external/package/mscc-mstp/Config.in
```kconfig
config BR2_PACKAGE_MSCC_MSTP
	bool "mscc-mstp"
	help
	  Tool for configuring mstp
```

## external/package/mscc-multicast-tools/Config.in
```kconfig
config BR2_PACKAGE_MSCC_MULTICAST_TOOLS
	bool "mscc multicast tools"
	help
	  Tool for register and send multicast frames
```

## external/package/mscc-qos-utils/Config.in
```kconfig
config BR2_PACKAGE_MSCC_QOS_UTILS
	bool "mscc-qos-utils"
	help
	  Tool for configuring qos
```

## external/package/mscc-spi-reg-access/Config.in
```kconfig
config BR2_PACKAGE_MSCC_SPI_REG_ACCESS
	bool "mscc-spi-reg-access"
	help
	  Tool for accessing registers in a Switch SoC via a SPI interface
```

## external/package/mscc-testptp/Config.in
```kconfig
config BR2_PACKAGE_MSCC_TESTPTP
	bool "mscc-testptp"
	help
	  Tool for testing ptp
```

## external/package/mscc-tiny-lldpd/Config.in
```kconfig
config BR2_PACKAGE_MSCC_TINY_LLDPD
	bool "mscc-tiny-lldpd"
	help
	  Tool for starting lldpd
```

## external/package/mscc-xz-embedded/Config.in
```kconfig
config BR2_PACKAGE_MSCC_XZ_EMBEDDED
	bool "mscc-xz-embedded"
	help
          XZ Embedded is a relatively small decompressor for the .xz
          file format. It was developed with the Linux kernel in mind,
          but it is easily usable in other projects too.

	  http://tukaani.org/xz/embedded.html
```

## external/package/poed/Config.in
```kconfig
config BR2_PACKAGE_POED
	bool "poed"
	help
	  Daemon for managing PoE (Specific driver required)
```
