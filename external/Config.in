## external/configs/mipsel_xstax_defconfig
```kconfig
BR2_mipsel=y
BR2_mips_32r2=y
BR2_TOOLCHAIN_EXTERNAL=y
BR2_TOOLCHAIN_EXTERNAL_CUSTOM=y
BR2_TOOLCHAIN_EXTERNAL_PATH="/opt/mscc/mscc-toolchain-bin-2024.02.6-108/mipsel-mips32r2-linux-gnu"
BR2_TOOLCHAIN_EXTERNAL_CUSTOM_GLIBC=y
BR2_TOOLCHAIN_EXTERNAL_HEADERS_5_4=y
BR2_TOOLCHAIN_EXTERNAL_GCC_13=y
BR2_TOOLCHAIN_EXTERNAL_CXX=y
# BR2_TOOLCHAIN_EXTERNAL_INET_RPC is not set
BR2_PRIMARY_SITE="http://soft02.microsemi.net/mirror"

BR2_SSP_NONE=y
BR2_RELRO_NONE=y
BR2_FORTIFY_SOURCE_NONE=y
# BR2_PIC_PIE is not set
BR2_TIME_BITS_64=y
BR2_LINUX_KERNEL=y
BR2_LINUX_KERNEL_CUSTOM_TARBALL=y
BR2_LINUX_KERNEL_CUSTOM_TARBALL_LOCATION="https://bitbucket.microchip.com/UNGE/sw-webstax-linux/archive/3df98e5ca722ed7bbc2ede0f76dbf492a8224ddc.tar.gz"
BR2_LINUX_KERNEL_VMLINUX_BIN=y
BR2_LINUX_KERNEL_XZ=y
BR2_LINUX_KERNEL_DEFCONFIG="microchip_xstax"
BR2_LINUX_KERNEL_DTS_SUPPORT=y
BR2_LINUX_KERNEL_INTREE_DTS_NAME="mscc/jaguar2_pcb110 mscc/jaguar2_pcb111 mscc/jaguar2_pcb118 mscc/luton_pcb090 mscc/luton_pcb091 mscc/ocelot_pcb120 mscc/ocelot_pcb123 mscc/serval2_pcb112 mscc/serval_pcb105 mscc/serval_pcb106 mscc/servalt_pcb116"
BR2_TARGET_GENERIC_HOSTNAME="vcoreiii"
BR2_TARGET_GENERIC_ISSUE="Welcome to SMBStaX"
BR2_ROOTFS_OVERLAY="board/mscc/common/rootfs_overlay"
BR2_PACKAGE_MTD=y
BR2_PACKAGE_MTD_MKFSJFFS2=y
BR2_PACKAGE_UBOOT_TOOLS=y
BR2_PACKAGE_LIBCURL=y
BR2_PACKAGE_LIBCURL_VERBOSE=y
BR2_PACKAGE_LIBSSH2=y

BR2_PACKAGE_BUSYBOX_CONFIG_FRAGMENT_FILES="package/busybox/mscc_fragment.config"
BR2_PACKAGE_BUSYBOX_SHOW_OTHERS=y
BR2_PACKAGE_JSON_C=y
BR2_PACKAGE_LIBFCGI=y
BR2_PACKAGE_LIBNET=y
BR2_PACKAGE_LIBUPNP=y
BR2_PACKAGE_DROPBEAR=y
# BR2_PACKAGE_DROPBEAR_CLIENT is not set
BR2_PACKAGE_HIAWATHA=y
BR2_PACKAGE_HIAWATHA_SSL=y
BR2_PACKAGE_HIAWATHA_TOOLKIT=y
BR2_PACKAGE_IPTABLES=y
BR2_PACKAGE_NETSNMP=y
# BR2_PACKAGE_NETSNMP_CLIENTS is not set
# BR2_PACKAGE_NETSNMP_ENABLE_MIBS is not set
BR2_PACKAGE_NETSNMP_WITH_MIB_MODULES="agentx mibII/vacm_vars mibII/vacm_conf mibII/snmp_mib snmpv3mibs"
BR2_PACKAGE_NETSNMP_WITHOUT_MIB_MODULES="disman/event disman/schedule utilities default_modules"
BR2_PACKAGE_NETSNMP_OPENSSL_INTERNAL=y
BR2_PACKAGE_NTP=y
BR2_TARGET_ROOTFS_SQUASHFS=y
BR2_TARGET_ROOTFS_SQUASHFS4_XZ=y
BR2_PACKAGE_PCIUTILS=y
BR2_PACKAGE_STRACE=y
BR2_PACKAGE_MBEDTLS=y
BR2_PACKAGE_LIBCURL_MBEDTLS=y
BR2_PACKAGE_LIBSSH2_MBEDTLS=y

BR2_PACKAGE_MSCC_XZ_EMBEDDED=y
BR2_PACKAGE_MSCC_DTS_OVERLAYS=y
BR2_PACKAGE_HOST_SQUASHFS=y
BR2_PACKAGE_HOST_GENEXT2FS=y
BR2_PACKAGE_HOST_DOSFSTOOLS=y
BR2_PACKAGE_HOST_MTD=y
BR2_PACKAGE_HOST_MTOOLS=y
BR2_PACKAGE_HOST_GENIMAGE=y
BR2_PACKAGE_HOST_UBOOT_TOOLS=y
BR2_PACKAGE_HOST_UBOOT_TOOLS_FIT_SUPPORT=y
BR2_PACKAGE_HOST_UBOOT_TOOLS_FIT_SIGNATURE_SUPPORT=y
BR2_PACKAGE_HOST_CMAKE=y
BR2_LINUX_KERNEL_CONFIG_FRAGMENT_FILES="board/microchip/xstax/mipsel_kernel.config"
# BR2_PACKAGE_MSCC_DTS_OVERLAYS is not set
```

## external/configs/mipsel_xstax_loader_defconfig
```kconfig
BR2_mipsel=y
BR2_mips_32r2=y
BR2_STATIC_LIBS=y
BR2_INIT_NONE=y
BR2_TARGET_GENERIC_HOSTNAME="vcoreiii"
BR2_TARGET_GENERIC_ISSUE="Welcome to SMBStaX"
# BR2_PACKAGE_BUSYBOX is not set
# BR2_TARGET_GENERIC_GETTY is not set
BR2_SYSTEM_BIN_SH_NONE=y
BR2_TARGET_ROOTFS_SQUASHFS=y
BR2_TARGET_ROOTFS_SQUASHFS4_XZ=y
BR2_PACKAGE_MBEDTLS=y
BR2_PACKAGE_ZLIB=y
BR2_TOOLCHAIN_EXTERNAL=y
BR2_TOOLCHAIN_EXTERNAL_CUSTOM=y
BR2_TOOLCHAIN_EXTERNAL_PATH="/opt/mscc/mscc-toolchain-bin-2024.02.6-108/mipsel-mips32r2-linux-uclibc"
BR2_TOOLCHAIN_EXTERNAL_HEADERS_5_4=y
BR2_TOOLCHAIN_EXTERNAL_GCC_13=y
BR2_TOOLCHAIN_EXTERNAL_CXX=y
# BR2_TOOLCHAIN_EXTERNAL_HAS_THREADS_DEBUG is not set
# BR2_TOOLCHAIN_EXTERNAL_INET_RPC is not set
BR2_PACKAGE_HOST_SQUASHFS=y
BR2_PACKAGE_HOST_GENEXT2FS=y
BR2_PACKAGE_HOST_DOSFSTOOLS=y
BR2_PACKAGE_HOST_MTD=y
BR2_PACKAGE_HOST_MTOOLS=y
BR2_PACKAGE_HOST_GENIMAGE=y
BR2_PACKAGE_HOST_UBOOT_TOOLS=y
BR2_PACKAGE_HOST_UBOOT_TOOLS_FIT_SUPPORT=y
BR2_PACKAGE_HOST_UBOOT_TOOLS_FIT_SIGNATURE_SUPPORT=y
BR2_PACKAGE_HOST_CMAKE=y
BR2_PRIMARY_SITE="http://soft02.microsemi.net/mirror"

BR2_SSP_NONE=y
BR2_RELRO_NONE=y
BR2_FORTIFY_SOURCE_NONE=y
# BR2_PIC_PIE is not set
BR2_TIME_BITS_64=y
```

## external/package/mscc-atf/Config.in.host
```kconfig
config BR2_PACKAGE_HOST_MSCC_ATF
	bool "host mscc-atf"
	help
	  ARM Trusted Firmware

if BR2_PACKAGE_HOST_MSCC_ATF

config BR2_PACKAGE_HOST_MSCC_ATF_VERSION
	string "version of host-atf"
	help
	  "Select version of host-atf"

endif
```

## external/package/mscc-cfm/Config.in
```kconfig
config BR2_PACKAGE_MSCC_CFM
	bool "mscc-cfm"
	select BR2_PACKAGE_LIBNL
	select BR2_PACKAGE_LIBEV
	select BR2_PACKAGE_LIBMNL
	help
	  Continuity Fault Management
```

## external/package/mscc-cml-utils/Config.in
```kconfig
config BR2_PACKAGE_MSCC_CML_UTILS
	bool "mscc-cml-utils"
	select BR2_PACKAGE_LIBNL
	help
	  Tool for reading registers

if BR2_PACKAGE_MSCC_CML_UTILS

config BR2_PACKAGE_MSCC_CML_UTILS_LAN966X
	bool "symreg-lan966x"
	default n
	help
	  enable the symreg build for LAN966X chips

config BR2_PACKAGE_MSCC_CML_UTILS_SPARX5
	bool "symreg-sparx5"
	default n
	help
	  enable the symreg build for SPARX5 chips

config BR2_PACKAGE_MSCC_CML_UTILS_LAN969X
	bool "symreg-lan969x"
	default n
	help
	  enable the symreg build for LAN969x chips

config BR2_PACKAGE_MSCC_CML_UTILS_VCAP_TOOL
	bool "common-vcap"
	default n
	help
	  enable the common VCAP tool build for LAN966x, Sparx5 or LAN969x

endif
```

## external/package/mscc-dts-overlays/Config.in
```kconfig
config BR2_PACKAGE_MSCC_DTS_OVERLAYS
	bool "mscc-dts-overlays"
	help
	  Build dts overlays
```

## external/package/mscc-easyframes/Config.in
```kconfig
config BR2_PACKAGE_MSCC_EASYFRAMES
	bool "mscc-easyframes"
	select BR2_PACKAGE_LIBPCAP
	select BR2_PACKAGE_ZLIB
	help
	  Tool for generating frames
```

## external/package/mscc-easyrun/Config.in
```kconfig
config BR2_PACKAGE_MSCC_EASYRUN
	bool "mscc-easyrun"
	help
	  Tool for generating frames
```

## external/package/mscc-ef-loop/Config.in
```kconfig
config BR2_PACKAGE_MSCC_EF_LOOP
	bool "mscc-ef-loop"
	select BR2_PACKAGE_LIBEV
	help
	  Tool for creating loops in userspace
```

## external/package/mscc-erps/Config.in
```kconfig
config BR2_PACKAGE_MSCC_ERPS
	bool "mscc-erps"
	select BR2_PACKAGE_LIBNL
	select BR2_PACKAGE_LIBEV
	select BR2_PACKAGE_LIBMNL
	help
	  Ethernet Ring Protection - G.8032
```

## external/package/mscc-gpio-ctrl/Config.in
```kconfig
config BR2_PACKAGE_MSCC_GPIO_CTRL
	bool "mscc-gpio-ctrl"
	help
	  Tool for controlling the gpio devices
```

## external/package/mscc-mera/Config.in
```kconfig
config BR2_PACKAGE_MSCC_MERA
	bool "mscc-mera"
	help
	  Library for Microchip Ethernet RTE API
```
