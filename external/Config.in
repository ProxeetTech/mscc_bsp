## external/configs/arm_bootloaders_defconfig
```kconfig
BR2_arm=y
BR2_cortex_a8=y
BR2_TOOLCHAIN_EXTERNAL=y
BR2_TOOLCHAIN_EXTERNAL_CUSTOM=y
BR2_TOOLCHAIN_EXTERNAL_PATH="/opt/mscc/mscc-toolchain-bin-2024.02.6-108/arm-cortex_a8-linux-gnueabihf"
BR2_TOOLCHAIN_EXTERNAL_CUSTOM_GLIBC=y
BR2_TOOLCHAIN_EXTERNAL_HEADERS_5_4=y
BR2_TOOLCHAIN_EXTERNAL_GCC_13=y
BR2_TOOLCHAIN_EXTERNAL_CXX=y
# BR2_TOOLCHAIN_EXTERNAL_INET_RPC is not set
BR2_PRIMARY_SITE="http://soft02.microsemi.net/mirror"

BR2_SSP_NONE=y
BR2_RELRO_NONE=y
BR2_FORTIFY_SOURCE_NONE=y
# BR2_PIC_PIE is not set
BR2_TIME_BITS_64=y
BR2_TARGET_MSCC_MUBOOT=y
BR2_MSCC_MUBOOT_REPO="https://bitbucket.microchip.com/UNGE/sw-uboot/archive"
BR2_MSCC_MUBOOT_VERSION="d01a625c5262bf1f716d424da64c3dfd248d85b4"
BR2_MSCC_MUBOOT_TARGETS="mchp_lan966x_evb mchp_lan966x_svb"
BR2_PACKAGE_HOST_UBOOT_TOOLS=y
BR2_PACKAGE_HOST_UBOOT_TOOLS_FIT_SUPPORT=y
BR2_PACKAGE_HOST_UBOOT_TOOLS_FIT_SIGNATURE_SUPPORT=y

BR2_INIT_NONE=y
# BR2_PACKAGE_BUSYBOX is not set
# BR2_TARGET_GENERIC_GETTY is not set
BR2_SYSTEM_BIN_SH_NONE=y
# BR2_TARGET_ROOTFS_TAR is not set
BR2_PACKAGE_HOST_MSCC_ATF=y
BR2_PACKAGE_HOST_MSCC_ATF_VERSION="v2.8.8-mchp1"
BR2_ROOTFS_POST_IMAGE_SCRIPT="board/lan966x/gen-uboot.rb"
```

## external/configs/arm_standalone_defconfig
```kconfig
BR2_arm=y
BR2_cortex_a8=y
BR2_TOOLCHAIN_EXTERNAL=y
BR2_TOOLCHAIN_EXTERNAL_CUSTOM=y
BR2_TOOLCHAIN_EXTERNAL_PATH="/opt/mscc/mscc-toolchain-bin-2024.02.6-108/arm-cortex_a8-linux-gnueabihf"
BR2_TOOLCHAIN_EXTERNAL_CUSTOM_GLIBC=y
BR2_TOOLCHAIN_EXTERNAL_HEADERS_5_4=y
BR2_TOOLCHAIN_EXTERNAL_GCC_13=y
BR2_TOOLCHAIN_EXTERNAL_CXX=y
# BR2_TOOLCHAIN_EXTERNAL_INET_RPC is not set
BR2_PRIMARY_SITE="http://soft02.microsemi.net/mirror"

BR2_SSP_NONE=y
BR2_RELRO_NONE=y
BR2_FORTIFY_SOURCE_NONE=y
# BR2_PIC_PIE is not set
BR2_TIME_BITS_64=y
BR2_LINUX_KERNEL=y
BR2_LINUX_KERNEL_CUSTOM_TARBALL=y
BR2_LINUX_KERNEL_CUSTOM_TARBALL_LOCATION="https://bitbucket.microchip.com/UNGE/sw-webstax-linux/archive/3df98e5ca722ed7bbc2ede0f76dbf492a8224ddc.tar.gz"
BR2_LINUX_KERNEL_XZ=y
BR2_LINUX_KERNEL_DEFCONFIG="microchip_standalone"
BR2_LINUX_KERNEL_DTS_SUPPORT=y
BR2_LINUX_KERNEL_INTREE_DTS_NAME="ti/omap/am335x-evm ti/omap/am335x-bone ti/omap/am335x-boneblack ti/omap/am335x-bonegreen ti/omap/am335x-evmsk ti/omap/am335x-boneblack-mscc ti/omap/am335x-boneblack-mscc-fpga microchip/lan966x-pcb8291 microchip/lan966x-pcb8290 microchip/lan966x-pcb8281 microchip/lan966x-pcb8281-rgmii microchip/lan966x-pcb8309 microchip/lan966x-pcb8385 microchip/lan966x-mesa-pcb8291 microchip/lan966x-mesa-pcb8281 microchip/lan966x-mesa-pcb8290 microchip/lan966x-mesa-pcb8309 microchip/lan966x-appl-pcb8290 microchip/lan966x-appl-pcb8291"
BR2_LINUX_KERNEL_DTB_OVERLAY_SUPPORT=y
BR2_PACKAGE_MSCC_CML_UTILS=y

BR2_ROOTFS_POST_IMAGE_SCRIPT="board/lan966x/post-image.sh"
BR2_PACKAGE_BUSYBOX_CONFIG_FRAGMENT_FILES="package/busybox/mscc_fragment.config"
BR2_PACKAGE_BUSYBOX_SHOW_OTHERS=y
BR2_PACKAGE_JSON_C=y
BR2_PACKAGE_LIBFCGI=y
BR2_PACKAGE_LIBNET=y
BR2_PACKAGE_LIBUPNP=y
BR2_PACKAGE_DROPBEAR=y
# BR2_PACKAGE_DROPBEAR_CLIENT is not set
BR2_PACKAGE_DHCP=y
BR2_PACKAGE_DHCP_CLIENT=y
BR2_PACKAGE_HIAWATHA=y
BR2_PACKAGE_HIAWATHA_SSL=y
BR2_PACKAGE_HIAWATHA_TOOLKIT=y
BR2_PACKAGE_IPTABLES=y
BR2_PACKAGE_PCIUTILS=y
BR2_PACKAGE_MTD=y
BR2_PACKAGE_MTD_MKFSJFFS2=y
BR2_PACKAGE_UBOOT_TOOLS=y
BR2_PACKAGE_LIBCURL=y
BR2_PACKAGE_LIBCURL_VERBOSE=y
BR2_PACKAGE_LIBSSH2=y

BR2_TARGET_ROOTFS_EXT2=y
BR2_TARGET_ROOTFS_EXT2_4=y
BR2_TARGET_ROOTFS_SQUASHFS=y
BR2_TARGET_ROOTFS_SQUASHFS4_XZ=y
BR2_TARGET_GENERIC_HOSTNAME="vcoreiii"
BR2_TARGET_GENERIC_ISSUE="Welcome to SMBStaX"

BR2_ROOTFS_OVERLAY="board/mscc/common/rootfs_overlay"

BR2_PACKAGE_BRIDGE_UTILS=y
BR2_PACKAGE_EBTABLES=y
BR2_PACKAGE_PHYTOOL=y
BR2_PACKAGE_TCPDUMP=y
BR2_PACKAGE_STRACE=y
BR2_PACKAGE_IPERF3=y
BR2_PACKAGE_IPROUTE2=y
BR2_PACKAGE_ELFUTILS=y
BR2_PACKAGE_IPUTILS=y
BR2_PACKAGE_ETHTOOL=y
BR2_PACKAGE_RAMSPEED=y
BR2_PACKAGE_OPEN_LLDP=y
BR2_PACKAGE_VIM=y
BR2_PACKAGE_WATCHDOG=y

BR2_PACKAGE_LIBSOCKETCAN=y
BR2_PACKAGE_DIEHARDER=y
BR2_PACKAGE_MEMTESTER=y

BR2_PACKAGE_MSCC_QOS_UTILS=y
BR2_PACKAGE_MSCC_TINY_LLDPD=y
BR2_PACKAGE_MSCC_DTS_OVERLAYS=y
BR2_PACKAGE_MSCC_EASYRUN=y
BR2_PACKAGE_MSCC_MRP=y
BR2_PACKAGE_MSCC_EASYFRAMES=y
BR2_PACKAGE_MSCC_LINUXPTP=y
BR2_PACKAGE_MSCC_XZ_EMBEDDED=y
BR2_PACKAGE_MSCC_EF_LOOP=y
BR2_PACKAGE_MSCC_MULTICAST_TOOLS=y
BR2_PACKAGE_MSCC_GPIO_CTRL=y
BR2_PACKAGE_MSCC_TESTPTP=y
BR2_PACKAGE_HOST_SQUASHFS=y
BR2_PACKAGE_HOST_GENEXT2FS=y
BR2_PACKAGE_HOST_DOSFSTOOLS=y
BR2_PACKAGE_HOST_MTD=y
BR2_PACKAGE_HOST_MTOOLS=y
BR2_PACKAGE_HOST_GENIMAGE=y
BR2_PACKAGE_HOST_UBOOT_TOOLS=y
BR2_PACKAGE_HOST_UBOOT_TOOLS_FIT_SUPPORT=y
BR2_PACKAGE_HOST_UBOOT_TOOLS_FIT_SIGNATURE_SUPPORT=y
BR2_PACKAGE_HOST_CMAKE=y
BR2_PACKAGE_E2FSPROGS=y
BR2_PACKAGE_E2FSPROGS_RESIZE2FS=y
BR2_PACKAGE_GPTFDISK=y
BR2_PACKAGE_GPTFDISK_GDISK=y
BR2_PACKAGE_GPTFDISK_SGDISK=y
BR2_TARGET_ROOTFS_EXT2=y
BR2_TARGET_ROOTFS_EXT2_4=y
BR2_TARGET_ROOTFS_EXT2_LABEL=""
BR2_TARGET_ROOTFS_EXT2_SIZE="120M"
BR2_TARGET_ROOTFS_EXT2_MKFS_OPTIONS="-O ^64bit"
BR2_LINUX_KERNEL_CONFIG_FRAGMENT_FILES="board/microchip/standalone/arm_kernel.config"
BR2_PACKAGE_STRESS_NG=y
BR2_PACKAGE_PYTHON3=y
BR2_PACKAGE_PYTHON_SMBUS_CFFI=y
BR2_PACKAGE_CRYPTSETUP=y
BR2_PACKAGE_MSCC_OTP=y
BR2_PACKAGE_MSCC_MERA=y
BR2_PACKAGE_MSCC_RTLABS_PNET=y
BR2_PACKAGE_MSCC_OSAL=y
BR2_PACKAGE_MSCC_PMAC=y
BR2_PACKAGE_MSCC_CML_UTILS=y
BR2_PACKAGE_MSCC_CML_UTILS_LAN966X=y
BR2_PACKAGE_MSCC_CML_UTILS_VCAP_TOOL=y
BR2_PACKAGE_MSCC_SPI_REG_ACCESS=y
# BR2_PACKAGE_MSCC_CML_UTILS_SPARX5 is not set
# BR2_PACKAGE_MSCC_CML_UTILS_LAN969X is not set
BR2_ROOTFS_OVERLAY="board/mscc/common/rootfs_overlay"
```

## external/configs/arm_xstax_defconfig
```kconfig
BR2_arm=y
BR2_cortex_a8=y
BR2_TOOLCHAIN_EXTERNAL=y
BR2_TOOLCHAIN_EXTERNAL_CUSTOM=y
BR2_TOOLCHAIN_EXTERNAL_PATH="/opt/mscc/mscc-toolchain-bin-2024.02.6-108/arm-cortex_a8-linux-gnueabihf"
BR2_TOOLCHAIN_EXTERNAL_CUSTOM_GLIBC=y
BR2_TOOLCHAIN_EXTERNAL_HEADERS_5_4=y
BR2_TOOLCHAIN_EXTERNAL_GCC_13=y
BR2_TOOLCHAIN_EXTERNAL_CXX=y
# BR2_TOOLCHAIN_EXTERNAL_INET_RPC is not set
BR2_PRIMARY_SITE="http://soft02.microsemi.net/mirror"

BR2_SSP_NONE=y
BR2_RELRO_NONE=y
BR2_FORTIFY_SOURCE_NONE=y
# BR2_PIC_PIE is not set
BR2_TIME_BITS_64=y
BR2_LINUX_KERNEL=y
BR2_LINUX_KERNEL_CUSTOM_TARBALL=y
BR2_LINUX_KERNEL_CUSTOM_TARBALL_LOCATION="https://bitbucket.microchip.com/UNGE/sw-webstax-linux/archive/3df98e5ca722ed7bbc2ede0f76dbf492a8224ddc.tar.gz"
BR2_LINUX_KERNEL_XZ=y
BR2_LINUX_KERNEL_DEFCONFIG="microchip_xstax"
BR2_LINUX_KERNEL_DTS_SUPPORT=y
BR2_LINUX_KERNEL_INTREE_DTS_NAME="microchip/lan966x-pcb8291 microchip/lan966x-pcb8290 microchip/lan966x-pcb8281 microchip/lan966x-pcb8281-rgmii microchip/lan966x-pcb8309 microchip/lan966x-pcb8385 microchip/lan966x-mesa-pcb8291 microchip/lan966x-mesa-pcb8281 microchip/lan966x-mesa-pcb8290 microchip/lan966x-mesa-pcb8309 microchip/lan966x-appl-pcb8290 microchip/lan966x-appl-pcb8291 microchip/lan966x-appl-pcb8385"
BR2_LINUX_KERNEL_DTB_OVERLAY_SUPPORT=y
BR2_PACKAGE_MSCC_CML_UTILS=y
BR2_TARGET_GENERIC_HOSTNAME="vcoreiii"
BR2_TARGET_GENERIC_ISSUE="Welcome to SMBStaX"
BR2_ROOTFS_OVERLAY="board/mscc/common/rootfs_overlay"
BR2_PACKAGE_MTD=y
BR2_PACKAGE_MTD_MKFSJFFS2=y
BR2_PACKAGE_UBOOT_TOOLS=y
BR2_PACKAGE_LIBCURL=y
BR2_PACKAGE_LIBCURL_VERBOSE=y
BR2_PACKAGE_LIBSSH2=y

BR2_PACKAGE_BUSYBOX_CONFIG_FRAGMENT_FILES="package/busybox/mscc_fragment.config"
BR2_PACKAGE_BUSYBOX_SHOW_OTHERS=y
BR2_PACKAGE_JSON_C=y
BR2_PACKAGE_LIBFCGI=y
BR2_PACKAGE_LIBNET=y
BR2_PACKAGE_LIBUPNP=y
BR2_PACKAGE_DROPBEAR=y
# BR2_PACKAGE_DROPBEAR_CLIENT is not set
BR2_PACKAGE_HIAWATHA=y
BR2_PACKAGE_HIAWATHA_SSL=y
BR2_PACKAGE_HIAWATHA_TOOLKIT=y
BR2_PACKAGE_IPTABLES=y
BR2_PACKAGE_NETSNMP=y
# BR2_PACKAGE_NETSNMP_CLIENTS is not set
# BR2_PACKAGE_NETSNMP_ENABLE_MIBS is not set
BR2_PACKAGE_NETSNMP_WITH_MIB_MODULES="agentx mibII/vacm_vars mibII/vacm_conf mibII/snmp_mib snmpv3mibs"
BR2_PACKAGE_NETSNMP_WITHOUT_MIB_MODULES="disman/event disman/schedule utilities default_modules"
BR2_PACKAGE_NETSNMP_OPENSSL_INTERNAL=y
BR2_PACKAGE_NTP=y
BR2_TARGET_ROOTFS_SQUASHFS=y
BR2_TARGET_ROOTFS_SQUASHFS4_XZ=y
BR2_PACKAGE_PCIUTILS=y
BR2_PACKAGE_STRACE=y
BR2_PACKAGE_MBEDTLS=y
BR2_PACKAGE_LIBCURL_MBEDTLS=y
BR2_PACKAGE_LIBSSH2_MBEDTLS=y

BR2_PACKAGE_MSCC_XZ_EMBEDDED=y
BR2_PACKAGE_MSCC_DTS_OVERLAYS=y
BR2_PACKAGE_HOST_SQUASHFS=y
BR2_PACKAGE_HOST_GENEXT2FS=y
BR2_PACKAGE_HOST_DOSFSTOOLS=y
BR2_PACKAGE_HOST_MTD=y
BR2_PACKAGE_HOST_MTOOLS=y
BR2_PACKAGE_HOST_GENIMAGE=y
BR2_PACKAGE_HOST_UBOOT_TOOLS=y
BR2_PACKAGE_HOST_UBOOT_TOOLS_FIT_SUPPORT=y
BR2_PACKAGE_HOST_UBOOT_TOOLS_FIT_SIGNATURE_SUPPORT=y
BR2_PACKAGE_HOST_CMAKE=y
BR2_PACKAGE_E2FSPROGS=y
BR2_PACKAGE_E2FSPROGS_RESIZE2FS=y
BR2_PACKAGE_GPTFDISK=y
BR2_PACKAGE_GPTFDISK_GDISK=y
BR2_PACKAGE_GPTFDISK_SGDISK=y
BR2_TARGET_ROOTFS_EXT2=y
BR2_TARGET_ROOTFS_EXT2_4=y
BR2_TARGET_ROOTFS_EXT2_LABEL=""
BR2_TARGET_ROOTFS_EXT2_SIZE="120M"
BR2_TARGET_ROOTFS_EXT2_MKFS_OPTIONS="-O ^64bit"
BR2_LINUX_KERNEL_CONFIG_FRAGMENT_FILES="board/microchip/xstax/arm_kernel.config"
BR2_PACKAGE_MSCC_OTP=y
BR2_PACKAGE_PYTHON3=y
BR2_PACKAGE_PYTHON_SMBUS_CFFI=y
BR2_PACKAGE_CRYPTSETUP=y
BR2_PACKAGE_MSCC_CML_UTILS=y
BR2_PACKAGE_MSCC_CML_UTILS_LAN966X=y
BR2_PACKAGE_MSCC_CML_UTILS_VCAP_TOOL=y
# BR2_PACKAGE_MSCC_CML_UTILS_SPARX5 is not set
# BR2_PACKAGE_MSCC_CML_UTILS_LAN969X is not set
```

## external/configs/mipsel_bootloaders_defconfig
```kconfig
BR2_mipsel=y
BR2_mips_32r2=y
BR2_TOOLCHAIN_EXTERNAL=y
BR2_TOOLCHAIN_EXTERNAL_CUSTOM=y
BR2_TOOLCHAIN_EXTERNAL_PATH="/opt/mscc/mscc-toolchain-bin-2024.02.6-108/mipsel-mips32r2-linux-gnu"
BR2_TOOLCHAIN_EXTERNAL_CUSTOM_GLIBC=y
BR2_TOOLCHAIN_EXTERNAL_HEADERS_5_4=y
BR2_TOOLCHAIN_EXTERNAL_GCC_13=y
BR2_TOOLCHAIN_EXTERNAL_CXX=y
# BR2_TOOLCHAIN_EXTERNAL_INET_RPC is not set
BR2_PRIMARY_SITE="http://soft02.microsemi.net/mirror"

BR2_SSP_NONE=y
BR2_RELRO_NONE=y
BR2_FORTIFY_SOURCE_NONE=y
# BR2_PIC_PIE is not set
BR2_TIME_BITS_64=y
BR2_TARGET_MSCC_MUBOOT=y
BR2_MSCC_MUBOOT_REPO="https://bitbucket.microchip.com/UNGE/sw-uboot/archive"
BR2_MSCC_MUBOOT_VERSION="5c02702462885c883f5cc7c4c2ce3fabedbff694"
BR2_MSCC_MUBOOT_TARGETS="mscc_jr2 mscc_luton mscc_ocelot mscc_serval mscc_servalt"
BR2_PACKAGE_HOST_UBOOT_TOOLS=y
BR2_PACKAGE_HOST_UBOOT_TOOLS_FIT_SUPPORT=y
BR2_PACKAGE_HOST_UBOOT_TOOLS_FIT_SIGNATURE_SUPPORT=y

BR2_INIT_NONE=y
# BR2_PACKAGE_BUSYBOX is not set
# BR2_TARGET_GENERIC_GETTY is not set
BR2_SYSTEM_BIN_SH_NONE=y
# BR2_TARGET_ROOTFS_TAR is not set
BR2_ROOTFS_POST_IMAGE_SCRIPT="board/mscc/rename-sign-uboot.rb"
```

## external/configs/mipsel_standalone_defconfig
```kconfig
BR2_mipsel=y
BR2_mips_32r2=y
BR2_TOOLCHAIN_EXTERNAL=y
BR2_TOOLCHAIN_EXTERNAL_CUSTOM=y
BR2_TOOLCHAIN_EXTERNAL_PATH="/opt/mscc/mscc-toolchain-bin-2024.02.6-108/mipsel-mips32r2-linux-gnu"
BR2_TOOLCHAIN_EXTERNAL_CUSTOM_GLIBC=y
BR2_TOOLCHAIN_EXTERNAL_HEADERS_5_4=y
BR2_TOOLCHAIN_EXTERNAL_GCC_13=y
BR2_TOOLCHAIN_EXTERNAL_CXX=y
# BR2_TOOLCHAIN_EXTERNAL_INET_RPC is not set
BR2_PRIMARY_SITE="http://soft02.microsemi.net/mirror"

BR2_SSP_NONE=y
BR2_RELRO_NONE=y
BR2_FORTIFY_SOURCE_NONE=y
# BR2_PIC_PIE is not set
BR2_TIME_BITS_64=y
BR2_LINUX_KERNEL=y
BR2_LINUX_KERNEL_CUSTOM_TARBALL=y
BR2_LINUX_KERNEL_CUSTOM_TARBALL_LOCATION="https://bitbucket.microchip.com/UNGE/sw-webstax-linux/archive/3df98e5ca722ed7bbc2ede0f76dbf492a8224ddc.tar.gz"
BR2_LINUX_KERNEL_VMLINUX_BIN=y
BR2_LINUX_KERNEL_XZ=y
BR2_LINUX_KERNEL_DEFCONFIG="microchip_standalone"
BR2_LINUX_KERNEL_DTS_SUPPORT=y
BR2_LINUX_KERNEL_INTREE_DTS_NAME="mscc/ocelot_pcb120 mscc/ocelot_pcb123"
BR2_LINUX_KERNEL_UIMAGE=y

BR2_ROOTFS_POST_IMAGE_SCRIPT="board/ocelot/gen-fit.rb"
BR2_PACKAGE_BUSYBOX_CONFIG_FRAGMENT_FILES="package/busybox/mscc_fragment.config"
BR2_PACKAGE_BUSYBOX_SHOW_OTHERS=y
BR2_PACKAGE_JSON_C=y
BR2_PACKAGE_LIBFCGI=y
BR2_PACKAGE_LIBNET=y
BR2_PACKAGE_LIBUPNP=y
BR2_PACKAGE_DROPBEAR=y
# BR2_PACKAGE_DROPBEAR_CLIENT is not set
BR2_PACKAGE_DHCP=y
BR2_PACKAGE_DHCP_CLIENT=y
BR2_PACKAGE_HIAWATHA=y
BR2_PACKAGE_HIAWATHA_SSL=y
BR2_PACKAGE_HIAWATHA_TOOLKIT=y
BR2_PACKAGE_IPTABLES=y
BR2_PACKAGE_PCIUTILS=y
BR2_PACKAGE_MTD=y
BR2_PACKAGE_MTD_MKFSJFFS2=y
BR2_PACKAGE_UBOOT_TOOLS=y
BR2_PACKAGE_LIBCURL=y
BR2_PACKAGE_LIBCURL_VERBOSE=y
BR2_PACKAGE_LIBSSH2=y

BR2_TARGET_ROOTFS_EXT2=y
BR2_TARGET_ROOTFS_EXT2_4=y
BR2_TARGET_ROOTFS_SQUASHFS=y
BR2_TARGET_ROOTFS_SQUASHFS4_XZ=y
BR2_TARGET_GENERIC_HOSTNAME="vcoreiii"
BR2_TARGET_GENERIC_ISSUE="Welcome to SMBStaX"

BR2_ROOTFS_OVERLAY="board/mscc/common/rootfs_overlay"

BR2_PACKAGE_BRIDGE_UTILS=y
BR2_PACKAGE_EBTABLES=y
BR2_PACKAGE_PHYTOOL=y
BR2_PACKAGE_TCPDUMP=y
BR2_PACKAGE_STRACE=y
BR2_PACKAGE_IPERF3=y
BR2_PACKAGE_IPROUTE2=y
BR2_PACKAGE_ELFUTILS=y
BR2_PACKAGE_IPUTILS=y
BR2_PACKAGE_ETHTOOL=y
BR2_PACKAGE_RAMSPEED=y
BR2_PACKAGE_OPEN_LLDP=y
BR2_PACKAGE_VIM=y
BR2_PACKAGE_WATCHDOG=y

BR2_PACKAGE_LIBSOCKETCAN=y
BR2_PACKAGE_DIEHARDER=y
BR2_PACKAGE_MEMTESTER=y

BR2_PACKAGE_MSCC_QOS_UTILS=y
BR2_PACKAGE_MSCC_TINY_LLDPD=y
BR2_PACKAGE_MSCC_DTS_OVERLAYS=y
BR2_PACKAGE_MSCC_EASYRUN=y
BR2_PACKAGE_MSCC_MRP=y
BR2_PACKAGE_MSCC_EASYFRAMES=y
BR2_PACKAGE_MSCC_LINUXPTP=y
BR2_PACKAGE_MSCC_XZ_EMBEDDED=y
BR2_PACKAGE_MSCC_EF_LOOP=y
BR2_PACKAGE_MSCC_MULTICAST_TOOLS=y
BR2_PACKAGE_MSCC_GPIO_CTRL=y
BR2_PACKAGE_MSCC_TESTPTP=y
BR2_PACKAGE_HOST_SQUASHFS=y
BR2_PACKAGE_HOST_GENEXT2FS=y
BR2_PACKAGE_HOST_DOSFSTOOLS=y
BR2_PACKAGE_HOST_MTD=y
BR2_PACKAGE_HOST_MTOOLS=y
BR2_PACKAGE_HOST_GENIMAGE=y
BR2_PACKAGE_HOST_UBOOT_TOOLS=y
BR2_PACKAGE_HOST_UBOOT_TOOLS_FIT_SUPPORT=y
BR2_PACKAGE_HOST_UBOOT_TOOLS_FIT_SIGNATURE_SUPPORT=y
BR2_PACKAGE_HOST_CMAKE=y
BR2_PACKAGE_E2FSPROGS=y
BR2_PACKAGE_E2FSPROGS_RESIZE2FS=y
BR2_PACKAGE_GPTFDISK=y
BR2_PACKAGE_GPTFDISK_GDISK=y
BR2_PACKAGE_GPTFDISK_SGDISK=y
BR2_TARGET_ROOTFS_EXT2=y
BR2_TARGET_ROOTFS_EXT2_4=y
BR2_TARGET_ROOTFS_EXT2_LABEL=""
BR2_TARGET_ROOTFS_EXT2_SIZE="120M"
BR2_TARGET_ROOTFS_EXT2_MKFS_OPTIONS="-O ^64bit"
BR2_LINUX_KERNEL_CONFIG_FRAGMENT_FILES="board/microchip/standalone/mipsel_kernel.config"
```
