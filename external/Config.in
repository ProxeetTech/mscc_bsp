## external/Config.in
```kconfig
source "$BR2_EXTERNAL_MSCC_PATH/boot/mscc-muboot/Config.in"
source "$BR2_EXTERNAL_MSCC_PATH/package/mscc-atf/Config.in.host"
source "$BR2_EXTERNAL_MSCC_PATH/package/mscc-cfm/Config.in"
source "$BR2_EXTERNAL_MSCC_PATH/package/mscc-cml-utils/Config.in"
source "$BR2_EXTERNAL_MSCC_PATH/package/mscc-dts-overlays/Config.in"
source "$BR2_EXTERNAL_MSCC_PATH/package/mscc-easyframes/Config.in"
source "$BR2_EXTERNAL_MSCC_PATH/package/mscc-easyrun/Config.in"
source "$BR2_EXTERNAL_MSCC_PATH/package/mscc-ef-loop/Config.in"
source "$BR2_EXTERNAL_MSCC_PATH/package/mscc-erps/Config.in"
source "$BR2_EXTERNAL_MSCC_PATH/package/mscc-gpio-ctrl/Config.in"
source "$BR2_EXTERNAL_MSCC_PATH/package/mscc-linuxptp/Config.in"
source "$BR2_EXTERNAL_MSCC_PATH/package/mscc-mera/Config.in"
source "$BR2_EXTERNAL_MSCC_PATH/package/mscc-mrp/Config.in"
source "$BR2_EXTERNAL_MSCC_PATH/package/mscc-mstp/Config.in"
source "$BR2_EXTERNAL_MSCC_PATH/package/mscc-multicast-tools/Config.in"
source "$BR2_EXTERNAL_MSCC_PATH/package/mscc-osal/Config.in"
source "$BR2_EXTERNAL_MSCC_PATH/package/mscc-otp/Config.in"
source "$BR2_EXTERNAL_MSCC_PATH/package/mscc-pmac/Config.in"
source "$BR2_EXTERNAL_MSCC_PATH/package/mscc-qos-utils/Config.in"
source "$BR2_EXTERNAL_MSCC_PATH/package/mscc-rtlabs-pnet/Config.in"
source "$BR2_EXTERNAL_MSCC_PATH/package/mscc-spi-reg-access/Config.in"
source "$BR2_EXTERNAL_MSCC_PATH/package/mscc-testptp/Config.in"
source "$BR2_EXTERNAL_MSCC_PATH/package/mscc-tiny-lldpd/Config.in"
source "$BR2_EXTERNAL_MSCC_PATH/package/mscc-xz-embedded/Config.in"
source "$BR2_EXTERNAL_MSCC_PATH/package/poed/Config.in"
```

## external/boot/mscc-muboot/Config.in
```kconfig
config BR2_TARGET_MSCC_MUBOOT
        bool "mscc-muboot"
        help
          Generic target for multiple U-Boot builds

if BR2_TARGET_MSCC_MUBOOT

config BR2_MSCC_MUBOOT_REPO
	string "U-Boot Git repository"

config BR2_MSCC_MUBOOT_VERSION
	string "U-Boot version"
	help
	  This option allows to use a specific U-Boot version

config BR2_MSCC_MUBOOT_TARGETS
        string "Multiple U-Boot defconfig targets"
        help
          A space-separated list of defconfig names

config BR2_MSCC_MUBOOT_SPL
        bool "Copy also SPL"
        help
         In case that also SPL images need to be copy

endif
```

## external/configs/arm64_bootloaders_defconfig
```kconfig
BR2_aarch64=y
BR2_cortex_a53=y
BR2_TOOLCHAIN_EXTERNAL=y
BR2_TOOLCHAIN_EXTERNAL_CUSTOM=y
BR2_TOOLCHAIN_EXTERNAL_PATH="/opt/mscc/mscc-toolchain-bin-2024.02.6-108/arm64-armv8_a-linux-gnu"
BR2_TOOLCHAIN_EXTERNAL_CUSTOM_GLIBC=y
BR2_TOOLCHAIN_EXTERNAL_HEADERS_5_4=y
BR2_TOOLCHAIN_EXTERNAL_GCC_13=y
BR2_TOOLCHAIN_EXTERNAL_CXX=y
# BR2_TOOLCHAIN_EXTERNAL_INET_RPC is not set
BR2_PRIMARY_SITE="http://soft02.microsemi.net/mirror"

BR2_SSP_NONE=y
BR2_RELRO_NONE=y
BR2_FORTIFY_SOURCE_NONE=y
# BR2_PIC_PIE is not set
BR2_TIME_BITS_64=y
BR2_TARGET_MSCC_MUBOOT=y
BR2_MSCC_MUBOOT_REPO="https://bitbucket.microchip.com/UNGE/sw-uboot/archive"
BR2_MSCC_MUBOOT_VERSION="d01a625c5262bf1f716d424da64c3dfd248d85b4"
BR2_MSCC_MUBOOT_TARGETS="mscc_sparx5_pcb13x_emmc mscc_sparx5_pcb13x_nand mchp_lan969x mchp_lan969x_signed mchp_lan969x_sram"
BR2_PACKAGE_HOST_UBOOT_TOOLS=y
BR2_PACKAGE_HOST_UBOOT_TOOLS_FIT_SUPPORT=y
BR2_PACKAGE_HOST_UBOOT_TOOLS_FIT_SIGNATURE_SUPPORT=y

BR2_INIT_NONE=y
# BR2_PACKAGE_BUSYBOX is not set
# BR2_TARGET_GENERIC_GETTY is not set
BR2_SYSTEM_BIN_SH_NONE=y
# BR2_TARGET_ROOTFS_TAR is not set
BR2_PACKAGE_HOST_MSCC_ATF=y
BR2_PACKAGE_HOST_MSCC_ATF_VERSION="v2.8.8-mchp1"
BR2_ROOTFS_POST_IMAGE_SCRIPT="board/lan969x/gen-uboot.rb"
```

## external/configs/arm64_bootloaders_ls1046_defconfig
```kconfig
BR2_aarch64=y
BR2_cortex_a53=y
BR2_TOOLCHAIN_EXTERNAL=y
BR2_TOOLCHAIN_EXTERNAL_CUSTOM=y
BR2_TOOLCHAIN_EXTERNAL_PATH="/opt/mscc/mscc-toolchain-bin-2024.02.6-108/arm64-armv8_a-linux-gnu"
BR2_TOOLCHAIN_EXTERNAL_CUSTOM_GLIBC=y
BR2_TOOLCHAIN_EXTERNAL_HEADERS_5_4=y
BR2_TOOLCHAIN_EXTERNAL_GCC_13=y
BR2_TOOLCHAIN_EXTERNAL_CXX=y
# BR2_TOOLCHAIN_EXTERNAL_INET_RPC is not set
BR2_PRIMARY_SITE="http://soft02.microsemi.net/mirror"

BR2_SSP_NONE=y
BR2_RELRO_NONE=y
BR2_FORTIFY_SOURCE_NONE=y
# BR2_PIC_PIE is not set
BR2_TIME_BITS_64=y
BR2_TARGET_UBOOT=y
BR2_TARGET_UBOOT_BUILD_SYSTEM_KCONFIG=y
BR2_TARGET_UBOOT_CUSTOM_TARBALL=y
BR2_TARGET_UBOOT_CUSTOM_TARBALL_LOCATION="https://bitbucket.microchip.com/UNGE/sw-uboot/archive/d091660afab6de96eb0b95a8e4d8142e25536a08.tar.gz"
BR2_TARGET_UBOOT_USE_DEFCONFIG=y
BR2_TARGET_UBOOT_BOARD_DEFCONFIG="mpxls1046_fireant"
BR2_TARGET_UBOOT_SPL=y
BR2_TARGET_UBOOT_SPL_NAME="u-boot-with-spl-pbl.bin"
BR2_TARGET_UBOOT_NEEDS_DTC=y
BR2_PACKAGE_HOST_UBOOT_TOOLS=y
BR2_PACKAGE_HOST_UBOOT_TOOLS_FIT_SUPPORT=y
BR2_PACKAGE_HOST_UBOOT_TOOLS_FIT_SIGNATURE_SUPPORT=y

BR2_INIT_NONE=y
# BR2_PACKAGE_BUSYBOX is not set
# BR2_TARGET_GENERIC_GETTY is not set
BR2_SYSTEM_BIN_SH_NONE=y
# BR2_TARGET_ROOTFS_TAR is not set
```

## external/configs/arm64_bootloaders_rpi_defconfig
```kconfig
BR2_aarch64=y
BR2_cortex_a53=y
BR2_TOOLCHAIN_EXTERNAL=y
BR2_TOOLCHAIN_EXTERNAL_CUSTOM=y
BR2_TOOLCHAIN_EXTERNAL_PATH="/opt/mscc/mscc-toolchain-bin-2024.02.6-108/arm64-armv8_a-linux-gnu"
BR2_TOOLCHAIN_EXTERNAL_CUSTOM_GLIBC=y
BR2_TOOLCHAIN_EXTERNAL_HEADERS_5_4=y
BR2_TOOLCHAIN_EXTERNAL_GCC_13=y
BR2_TOOLCHAIN_EXTERNAL_CXX=y
# BR2_TOOLCHAIN_EXTERNAL_INET_RPC is not set
BR2_PRIMARY_SITE="http://soft02.microsemi.net/mirror"

BR2_SSP_NONE=y
BR2_RELRO_NONE=y
BR2_FORTIFY_SOURCE_NONE=y
# BR2_PIC_PIE is not set
BR2_TIME_BITS_64=y
BR2_TARGET_UBOOT=y
BR2_TARGET_UBOOT_BUILD_SYSTEM_KCONFIG=y
BR2_TARGET_UBOOT_CUSTOM_VERSION=y
BR2_TARGET_UBOOT_CUSTOM_VERSION_VALUE="2021.04"
BR2_TARGET_UBOOT_BOARD_DEFCONFIG="rpi_arm64"
BR2_PACKAGE_HOST_UBOOT_TOOLS=y
BR2_PACKAGE_HOST_UBOOT_TOOLS_FIT_SUPPORT=y
BR2_PACKAGE_HOST_UBOOT_TOOLS_FIT_SIGNATURE_SUPPORT=y

BR2_INIT_NONE=y
# BR2_PACKAGE_BUSYBOX is not set
# BR2_TARGET_GENERIC_GETTY is not set
BR2_SYSTEM_BIN_SH_NONE=y
BR2_TARGET_UBOOT_CONFIG_FRAGMENT_FILES="board/raspberrypi/u-boot.config"
# BR2_TARGET_ROOTFS_TAR is not set
BR2_ROOTFS_POST_IMAGE_SCRIPT="board/raspberrypi/cp-readme.sh"
```

## external/configs/arm64_standalone_defconfig
```kconfig
BR2_aarch64=y
BR2_cortex_a53=y
BR2_TOOLCHAIN_EXTERNAL=y
BR2_TOOLCHAIN_EXTERNAL_CUSTOM=y
BR2_TOOLCHAIN_EXTERNAL_PATH="/opt/mscc/mscc-toolchain-bin-2024.02.6-108/arm64-armv8_a-linux-gnu"
BR2_TOOLCHAIN_EXTERNAL_CUSTOM_GLIBC=y
BR2_TOOLCHAIN_EXTERNAL_HEADERS_5_4=y
BR2_TOOLCHAIN_EXTERNAL_GCC_13=y
BR2_TOOLCHAIN_EXTERNAL_CXX=y
# BR2_TOOLCHAIN_EXTERNAL_INET_RPC is not set
BR2_PRIMARY_SITE="http://soft02.microsemi.net/mirror"

BR2_SSP_NONE=y
BR2_RELRO_NONE=y
BR2_FORTIFY_SOURCE_NONE=y
# BR2_PIC_PIE is not set
BR2_TIME_BITS_64=y
BR2_LINUX_KERNEL=y
BR2_LINUX_KERNEL_CUSTOM_TARBALL=y
BR2_LINUX_KERNEL_CUSTOM_TARBALL_LOCATION="https://bitbucket.microchip.com/UNGE/sw-webstax-linux/archive/3df98e5ca722ed7bbc2ede0f76dbf492a8224ddc.tar.gz"
BR2_LINUX_KERNEL_XZ=y
BR2_LINUX_KERNEL_DEFCONFIG="microchip_standalone"
BR2_LINUX_KERNEL_DTS_SUPPORT=y
BR2_LINUX_KERNEL_INTREE_DTS_NAME="microchip/sparx5_pcb125 microchip/sparx5_appl_pcb134 microchip/sparx5_appl_pcb134_emmc microchip/sparx5_appl_pcb135 microchip/sparx5_appl_pcb135_emmc freescale/ls1046_pcb134 freescale/ls1046_pcb110 freescale/ls1046_pcb121 microchip/sparx5_pcb134 microchip/sparx5_pcb135 microchip/sparx5_pcb134_emmc microchip/sparx5_pcb135_emmc microchip/lan969x_ev23x71a microchip/lan969x_appl_ev23x71a microchip/lan969x_sr microchip/lan969x_pcb10001 microchip/lan969x_ev89p81a microchip/lan969x_appl_ev89p81a"
BR2_LINUX_KERNEL_DTB_OVERLAY_SUPPORT=y
BR2_PACKAGE_MSCC_CML_UTILS=y

BR2_ROOTFS_POST_IMAGE_SCRIPT="board/sparx5/post-image.sh"
BR2_PACKAGE_BUSYBOX_CONFIG_FRAGMENT_FILES="package/busybox/mscc_fragment.config"
BR2_PACKAGE_BUSYBOX_SHOW_OTHERS=y
BR2_PACKAGE_JSON_C=y
BR2_PACKAGE_LIBFCGI=y
BR2_PACKAGE_LIBNET=y
BR2_PACKAGE_LIBUPNP=y
BR2_PACKAGE_DROPBEAR=y
# BR2_PACKAGE_DROPBEAR_CLIENT is not set
BR2_PACKAGE_DHCP=y
BR2_PACKAGE_DHCP_CLIENT=y
BR2_PACKAGE_HIAWATHA=y
BR2_PACKAGE_HIAWATHA_SSL=y
BR2_PACKAGE_HIAWATHA_TOOLKIT=y
BR2_PACKAGE_IPTABLES=y
BR2_PACKAGE_PCIUTILS=y
BR2_PACKAGE_MTD=y
BR2_PACKAGE_MTD_MKFSJFFS2=y
BR2_PACKAGE_UBOOT_TOOLS=y
BR2_PACKAGE_LIBCURL=y
BR2_PACKAGE_LIBCURL_VERBOSE=y
BR2_PACKAGE_LIBSSH2=y

BR2_TARGET_ROOTFS_EXT2=y
BR2_TARGET_ROOTFS_EXT2_4=y
BR2_TARGET_ROOTFS_SQUASHFS=y
BR2_TARGET_ROOTFS_SQUASHFS4_XZ=y
BR2_TARGET_GENERIC_HOSTNAME="vcoreiii"
BR2_TARGET_GENERIC_ISSUE="Welcome to SMBStaX"

BR2_ROOTFS_OVERLAY="board/mscc/common/rootfs_overlay"

BR2_PACKAGE_BRIDGE_UTILS=y
BR2_PACKAGE_EBTABLES=y
BR2_PACKAGE_PHYTOOL=y
BR2_PACKAGE_TCPDUMP=y
BR2_PACKAGE_STRACE=y
BR2_PACKAGE_IPERF3=y
BR2_PACKAGE_IPROUTE2=y
BR2_PACKAGE_ELFUTILS=y
BR2_PACKAGE_IPUTILS=y
BR2_PACKAGE_ETHTOOL=y
BR2_PACKAGE_RAMSPEED=y
BR2_PACKAGE_OPEN_LLDP=y
BR2_PACKAGE_VIM=y
BR2_PACKAGE_WATCHDOG=y

BR2_PACKAGE_LIBSOCKETCAN=y
BR2_PACKAGE_DIEHARDER=y
BR2_PACKAGE_MEMTESTER=y

BR2_PACKAGE_MSCC_QOS_UTILS=y
BR2_PACKAGE_MSCC_TINY_LLDPD=y
BR2_PACKAGE_MSCC_DTS_OVERLAYS=y
BR2_PACKAGE_MSCC_EASYRUN=y
BR2_PACKAGE_MSCC_MRP=y
BR2_PACKAGE_MSCC_EASYFRAMES=y
BR2_PACKAGE_MSCC_LINUXPTP=y
BR2_PACKAGE_MSCC_XZ_EMBEDDED=y
BR2_PACKAGE_MSCC_EF_LOOP=y
BR2_PACKAGE_MSCC_MULTICAST_TOOLS=y
BR2_PACKAGE_MSCC_GPIO_CTRL=y
BR2_PACKAGE_MSCC_TESTPTP=y
BR2_PACKAGE_E2FSPROGS=y
BR2_PACKAGE_E2FSPROGS_RESIZE2FS=y
BR2_PACKAGE_GPTFDISK=y
BR2_PACKAGE_GPTFDISK_GDISK=y
BR2_PACKAGE_GPTFDISK_SGDISK=y
BR2_TARGET_ROOTFS_EXT2=y
BR2_TARGET_ROOTFS_EXT2_4=y
BR2_TARGET_ROOTFS_EXT2_LABEL=""
BR2_TARGET_ROOTFS_EXT2_SIZE="120M"
BR2_TARGET_ROOTFS_EXT2_MKFS_OPTIONS="-O ^64bit"
BR2_PACKAGE_HOST_SQUASHFS=y
BR2_PACKAGE_HOST_GENEXT2FS=y
BR2_PACKAGE_HOST_DOSFSTOOLS=y
BR2_PACKAGE_HOST_MTD=y
BR2_PACKAGE_HOST_MTOOLS=y
BR2_PACKAGE_HOST_GENIMAGE=y
BR2_PACKAGE_HOST_UBOOT_TOOLS=y
BR2_PACKAGE_HOST_UBOOT_TOOLS_FIT_SUPPORT=y
BR2_PACKAGE_HOST_UBOOT_TOOLS_FIT_SIGNATURE_SUPPORT=y
BR2_PACKAGE_HOST_CMAKE=y
BR2_LINUX_KERNEL_CONFIG_FRAGMENT_FILES="board/microchip/standalone/arm64_kernel.config"
BR2_PACKAGE_PYTHON3=y
BR2_PACKAGE_PYTHON_SMBUS_CFFI=y
BR2_PACKAGE_CRYPTSETUP=y
BR2_PACKAGE_MSCC_CML_UTILS=y
BR2_PACKAGE_MSCC_CML_UTILS_SPARX5=y
BR2_PACKAGE_MSCC_CML_UTILS_LAN969X=y
BR2_PACKAGE_MSCC_CML_UTILS_VCAP_TOOL=y
BR2_PACKAGE_MSCC_SPI_REG_ACCESS=y
# BR2_PACKAGE_MSCC_CML_UTILS_LAN966X is not set
BR2_PACKAGE_MSCC_OTP=y
```

## external/configs/arm64_xstax_defconfig
```kconfig
BR2_aarch64=y
BR2_TOOLCHAIN_EXTERNAL=y
BR2_TOOLCHAIN_EXTERNAL_CUSTOM=y
BR2_TOOLCHAIN_EXTERNAL_PATH="/opt/mscc/mscc-toolchain-bin-2024.02.6-108/arm64-armv8_a-linux-gnu"
BR2_TOOLCHAIN_EXTERNAL_HEADERS_5_4=y
BR2_TOOLCHAIN_EXTERNAL_CUSTOM_GLIBC=y
# BR2_TOOLCHAIN_EXTERNAL_INET_RPC is not set
BR2_TOOLCHAIN_EXTERNAL_CXX=y
BR2_PRIMARY_SITE="http://soft02.microsemi.net/mirror"
# BR2_PIC_PIE is not set
BR2_SSP_NONE=y
BR2_RELRO_NONE=y
BR2_FORTIFY_SOURCE_NONE=y
BR2_TARGET_GENERIC_HOSTNAME="vcoreiii"
BR2_TARGET_GENERIC_ISSUE="Welcome to SMBStaX"
BR2_ROOTFS_OVERLAY="board/mscc/common/rootfs_overlay"
BR2_ROOTFS_POST_FAKEROOT_SCRIPT="scripts/fix_sshkeys_permissions.sh"
BR2_ROOTFS_POST_IMAGE_SCRIPT="scripts/post_build.sh"
BR2_LINUX_KERNEL=y
BR2_LINUX_KERNEL_CUSTOM_GIT=y
BR2_LINUX_KERNEL_CUSTOM_REPO_URL="https://github.com/ProxeetTech/linux.git"
BR2_LINUX_KERNEL_CUSTOM_REPO_VERSION="microchip_xstax"
BR2_LINUX_KERNEL_DEFCONFIG="microchip_xstax"
BR2_LINUX_KERNEL_CONFIG_FRAGMENT_FILES="board/microchip/xstax/arm64_kernel.config"
BR2_LINUX_KERNEL_XZ=y
BR2_LINUX_KERNEL_DTS_SUPPORT=y
BR2_LINUX_KERNEL_INTREE_DTS_NAME="microchip/lan969x_appl_ev23x71a microchip/lan969x_appl_pxrouter_som_v01 microchip/lan969x_pxrouter_som_v01 microchip/lan969x_pxrouter_som_v02"
BR2_LINUX_KERNEL_DTB_OVERLAY_SUPPORT=y
BR2_PACKAGE_BUSYBOX_CONFIG_FRAGMENT_FILES="package/busybox/mscc_fragment.config"
BR2_PACKAGE_BUSYBOX_SHOW_OTHERS=y
BR2_PACKAGE_BUSYBOX_WATCHDOG=y
BR2_PACKAGE_STRACE=y
BR2_PACKAGE_E2FSPROGS=y
BR2_PACKAGE_E2FSPROGS_RESIZE2FS=y
BR2_PACKAGE_MTD=y
BR2_PACKAGE_MTD_MKFSJFFS2=y
BR2_PACKAGE_CRYPTSETUP=y
BR2_PACKAGE_GPTFDISK=y
BR2_PACKAGE_GPTFDISK_GDISK=y
BR2_PACKAGE_GPTFDISK_SGDISK=y
BR2_PACKAGE_PCIUTILS=y
BR2_PACKAGE_UBOOT_TOOLS=y
BR2_PACKAGE_PYTHON3=y
BR2_PACKAGE_PYTHON_SMBUS_CFFI=y
BR2_PACKAGE_LIBSSH2=y
BR2_PACKAGE_MBEDTLS=y
BR2_PACKAGE_LIBCONFUSE=y
BR2_PACKAGE_LIBCURL=y
BR2_PACKAGE_LIBCURL_VERBOSE=y
BR2_PACKAGE_LIBCURL_MBEDTLS=y
BR2_PACKAGE_LIBFCGI=y
BR2_PACKAGE_LIBNET=y
BR2_PACKAGE_LIBUEV=y
BR2_PACKAGE_LIBUPNP=y
BR2_PACKAGE_LIBITE=y
BR2_PACKAGE_LIBUCI=y
BR2_PACKAGE_DROPBEAR=y
# BR2_PACKAGE_DROPBEAR_CLIENT is not set
BR2_PACKAGE_HIAWATHA=y
BR2_PACKAGE_HIAWATHA_SSL=y
BR2_PACKAGE_HIAWATHA_TOOLKIT=y
BR2_PACKAGE_IPTABLES=y
BR2_PACKAGE_NETCAT=y
BR2_PACKAGE_NETSNMP=y
# BR2_PACKAGE_NETSNMP_CLIENTS is not set
# BR2_PACKAGE_NETSNMP_ENABLE_MIBS is not set
BR2_PACKAGE_NETSNMP_WITH_MIB_MODULES="agentx mibII/vacm_vars mibII/vacm_conf mibII/snmp_mib snmpv3mibs"
BR2_PACKAGE_NETSNMP_WITHOUT_MIB_MODULES="disman/event disman/schedule utilities default_modules"
BR2_PACKAGE_NTP=y
BR2_PACKAGE_OPENSSH=y
BR2_PACKAGE_TFTPD=y
BR2_PACKAGE_WATCHDOG=y
BR2_PACKAGE_NANO=y
# BR2_PACKAGE_NANO_TINY is not set
BR2_TARGET_ROOTFS_EXT2=y
BR2_TARGET_ROOTFS_EXT2_4=y
BR2_TARGET_ROOTFS_EXT2_LABEL=""
BR2_TARGET_ROOTFS_EXT2_SIZE="120M"
BR2_TARGET_ROOTFS_SQUASHFS=y
BR2_TARGET_ROOTFS_SQUASHFS4_XZ=y
BR2_PACKAGE_HOST_CMAKE=y
BR2_PACKAGE_HOST_DOSFSTOOLS=y
BR2_PACKAGE_HOST_GENEXT2FS=y
BR2_PACKAGE_HOST_GENIMAGE=y
BR2_PACKAGE_HOST_MTD=y
BR2_PACKAGE_HOST_MTOOLS=y
BR2_PACKAGE_HOST_SQUASHFS=y
BR2_PACKAGE_HOST_UBOOT_TOOLS=y
BR2_PACKAGE_HOST_UBOOT_TOOLS_FIT_SUPPORT=y
BR2_PACKAGE_HOST_UBOOT_TOOLS_FIT_SIGNATURE_SUPPORT=y
BR2_PACKAGE_MSCC_DTS_OVERLAYS=y
BR2_PACKAGE_MSCC_OTP=y
BR2_PACKAGE_MSCC_XZ_EMBEDDED=y
BR2_PACKAGE_POED=y
```

## external/configs/arm_bootloaders_bbb_defconfig
```kconfig
BR2_arm=y
BR2_cortex_a8=y
BR2_TOOLCHAIN_EXTERNAL=y
BR2_TOOLCHAIN_EXTERNAL_CUSTOM=y
BR2_TOOLCHAIN_EXTERNAL_PATH="/opt/mscc/mscc-toolchain-bin-2024.02.6-108/arm-cortex_a8-linux-gnueabihf"
BR2_TOOLCHAIN_EXTERNAL_CUSTOM_GLIBC=y
BR2_TOOLCHAIN_EXTERNAL_HEADERS_5_4=y
BR2_TOOLCHAIN_EXTERNAL_GCC_13=y
BR2_TOOLCHAIN_EXTERNAL_CXX=y
# BR2_TOOLCHAIN_EXTERNAL_INET_RPC is not set
BR2_PRIMARY_SITE="http://soft02.microsemi.net/mirror"

BR2_SSP_NONE=y
BR2_RELRO_NONE=y
BR2_FORTIFY_SOURCE_NONE=y
# BR2_PIC_PIE is not set
BR2_TIME_BITS_64=y
BR2_TARGET_UBOOT=y
BR2_TARGET_UBOOT_BUILD_SYSTEM_KCONFIG=y
BR2_TARGET_UBOOT_CUSTOM_VERSION=y
BR2_TARGET_UBOOT_CUSTOM_VERSION_VALUE="2018.09"
BR2_TARGET_UBOOT_BOARD_DEFCONFIG="am335x_evm"
BR2_TARGET_UBOOT_NEEDS_DTC=y
# BR2_TARGET_UBOOT_FORMAT_BIN is not set
BR2_TARGET_UBOOT_FORMAT_IMG=y
BR2_TARGET_UBOOT_SPL=y
BR2_TARGET_UBOOT_SPL_NAME="MLO"
BR2_PACKAGE_HOST_UBOOT_TOOLS=y
BR2_PACKAGE_HOST_UBOOT_TOOLS_FIT_SUPPORT=y
BR2_PACKAGE_HOST_UBOOT_TOOLS_FIT_SIGNATURE_SUPPORT=y

BR2_INIT_NONE=y
# BR2_PACKAGE_BUSYBOX is not set
# BR2_TARGET_GENERIC_GETTY is not set
BR2_SYSTEM_BIN_SH_NONE=y
# BR2_TARGET_ROOTFS_TAR is not set
BR2_ROOTFS_POST_IMAGE_SCRIPT="board/beaglebone/gen-image.rb"
```
